#pragma once
#include <stdint.h>
#include <algorithm>
namespace menufont {
struct Glyph {uint16_t code,offset;uint8_t w,h,advance;};
static const uint8_t alpha[]={
0,0,0,0,0,0,0,0,0,0,0,0,0,0,0,0,0,0,0,0,0,0,0,0,0,0,0,0,0,0,0,0,
0,0,0,0,0,0,0,0,0,0,0,0,0,0,0,0,0,0,0,0,0,0,0,11,80,0,165,0,10,80,0,165,
0,9,64,0,148,0,0,0,0,165,0,10,80,0,0,0,0,0,0,0,0,0,0,0,0,0,0,0,0,0,0,0,
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0,0,0,0,0,0,0,0,0,0,0,0,0,0,0,0,0,0,0,0,0,0,0,0,0,0,
};
static const Glyph font13[]={
{32,0,5,18,4},
{33,45,5,18,4},
{34,90,6,18,5},
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{8594,8091,12,18,11},
};
static const Glyph font15[]={
{32,8199,5,20,4},
{33,8249,5,20,4},
{34,8299,7,20,6},
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{8594,18349,14,20,13},
};
static const Glyph font16[]={
{32,18489,5,21,4},
{33,18542,6,21,5},
{34,18605,7,21,6},
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{8594,29788,15,21,14},
};
inline const Glyph& glyph(unsigned size,uint32_t code){
 const auto* p=size==13?font13:size==16?font16:font15;const unsigned n=size==13?sizeof(font13)/sizeof(*font13):size==16?sizeof(font16)/sizeof(*font16):sizeof(font15)/sizeof(*font15);
 for(unsigned i=0;i<n;++i)if(p[i].code==code)return p[i];return p['?'-32];
}
inline uint32_t next(const char*& p){uint32_t c=uint8_t(*p++);if(c<128)return c;unsigned n=c<224?1:c<240?2:3;uint32_t v=c&((1u<<(6-n))-1);while(n--&&*p)v=(v<<6)|(uint8_t(*p++)&63);return v;}
inline int width(const char* p,unsigned size=15){int w=0;for(unsigned i=0;p&&*p&&i<80;++i)w+=glyph(size,next(p)).advance;return w;}
inline uint16_t blend(uint16_t ink,uint16_t bg,unsigned a){
 const uint32_t r=((uint32_t(ink>>11)*a+uint32_t(bg>>11)*(15-a)+7)/15);
 const uint32_t g=(((uint32_t(ink>>5)&63)*a+(uint32_t(bg>>5)&63)*(15-a)+7)/15);
 const uint32_t b=(((uint32_t(ink)&31)*a+(uint32_t(bg)&31)*(15-a)+7)/15);
 return uint16_t((r<<11)|(g<<5)|b);
}
template<class L> void text(L& lcd,int x,int y,const char* p,uint16_t ink,uint16_t bg,int maxWidth=304,unsigned size=15){
 const int end=std::min(320,x+maxWidth);lcd.startWrite();
 for(unsigned n=0;p&&*p&&n<80;++n){const auto& g=glyph(size,next(p));if(x+g.w>end)break;
  for(unsigned row=0;row<g.h&&y+int(row)<240;++row){
   for(unsigned col=0;col<g.w;){unsigned i=row*g.w+col,v=alpha[g.offset+i/2],a=(i&1)?v&15:v>>4;const unsigned first=col++;if(!a)continue;
    while(col<g.w){i=row*g.w+col;v=alpha[g.offset+i/2];if(((i&1)?v&15:v>>4)!=a)break;++col;}
    if(x+int(first)>=0&&y+int(row)>=0)lcd.writeFillRect(x+first,y+row,col-first,1,blend(ink,bg,a));
   }
  }x+=g.advance;
 }lcd.endWrite();
}
}
